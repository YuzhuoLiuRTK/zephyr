## drivers/can/Kconfig.rtl87x2g
```kconfig
# RTL87X2G CAN configuration

# Copyright(c) 2020, Realtek Semiconductor Corporation.
# SPDX-License-Identifier: Apache-2.0

config CAN_RTL87X2G
	bool "RTL87X2G CAN driver"
	default y
	depends on DT_HAS_REALTEK_RTL87X2G_CAN_ENABLED
	select USE_HAL_REALTEK_CAN
	help
	  Enable the RTL87X2G CAN driver.

if CAN_RTL87X2G

config CAN_TX_MSG_BUF_NUM
	int "Number of message buffers used for tx"
	default 6
	range 0 15
	help
	  Defines the number of message buffers used for tx in the application.
	  
	  The tx and rx share 16 message buffers in total.
	  Each rx message buffer can filter one standard or extended ID.

	  The following equation determines the maximum total number for tx and rx:

	    CAN_TX_MSG_BUF_NUM + CAN_RX_MSG_BUF_NUM <= 16

config CAN_RX_MSG_BUF_NUM
	int "Number of message buffers used for rx"
	default 10
	range 0 15
	help
	  Defines the number of message buffers used for rx in the application.
	  
	  The tx and rx share 16 message buffers in total.
	  Each rx message buffer can filter one standard or extended ID.

	  The following equation determines the maximum total number for tx and rx:

	    CAN_TX_MSG_BUF_NUM + CAN_RX_MSG_BUF_NUM <= 16


config CAN_MAX_STD_ID_FILTER
	int "Maximum number of standard (11-bit) ID filters"
	default 5
	range 0 CAN_RX_MSG_BUF_NUM
	help
	  Defines the maximum number of filters with standard ID (11-bit)
	  that can be added by the application.
	  
	  The tx and rx share 16 message buffers in total.
	  Each rx message buffer can filter one standard or extended ID.

	  The following equation determines the maximum total number of
	  filters:

	    CAN_MAX_STD_ID_FILTER + CAN_MAX_EXT_ID_FILTER <= CAN_RX_MSG_BUF_NUM

config CAN_MAX_EXT_ID_FILTER
	int "Maximum number of extended (29-bit) ID filters"
	default 5
	range 0 CAN_RX_MSG_BUF_NUM
	help
	  Defines the maximum number of filters with extended ID (29-bit)
	  that can be added by the application.

	  The tx and rx share 16 message buffers in total.
	  Each rx message buffer can filter one standard or extended ID.

	  The following equation determines the maximum total number of
	  filters:

	    CAN_MAX_STD_ID_FILTER + CAN_MAX_EXT_ID_FILTER <= CAN_RX_MSG_BUF_NUM

endif # CAN_RTL87X2G
```

## dts/bindings/can/realtek,rtl87x2g-can.yaml
```yaml
description: RTL87X2G CAN controller

compatible: "realtek,rtl87x2g-can"

include: [can-controller.yaml, pinctrl-device.yaml]

properties:
  reg:
    required: true

  interrupts:
    required: true

  clocks:
    required: true

  pinctrl-0:
    required: true

  pinctrl-names:
    required: true

  master-can-reg:
    type: int
    description: master can reg when different from current instance
```
