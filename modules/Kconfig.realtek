## modules/Kconfig.realtek
```kconfig
# Copyright(c) 2024, Realtek Semiconductor Corporation.
# SPDX-License-Identifier: Apache-2.0

config ZEPHYR_HAL_REALTEK_MODULE
	bool

config REALTEK_BEE_HAS_PCK600
	bool
	help
	  Selected by SoCs whose HAL drives the Arm PCK-600 power control kit.

	  With PCK-600 every peripheral owns its power and clock control and
	  raises its own active request, its registers are retained across a
	  low power state and its pads switch to their sleep configuration in
	  hardware. Devices therefore only have to release their active
	  request to let the system enter a low power state.

	  Without PCK-600 the platform power manager takes the whole SoC down
	  at once, peripheral registers lose their content and pads have to be
	  switched by software, so devices have to save and restore their
	  context around a low power state.

config USE_HAL_REALTEK_ADC
	bool
	help
	  Enable HAL REALTEK ADC driver

config USE_HAL_REALTEK_TIM
	bool
	help
	  Enable HAL REALTEK TIM driver

config USE_HAL_REALTEK_ENHTIM
	bool
	help
	  Enable HAL REALTEK ENHTIM driver

config USE_HAL_REALTEK_RTC
	bool
	help
	  Enable HAL REALTEK RTC driver

config USE_HAL_REALTEK_DMA
	bool
	help
	  Enable HAL REALTEK DMA driver

config USE_HAL_REALTEK_GPIO
	bool
	help
	  Enable HAL REALTEK GPIO driver

config USE_HAL_REALTEK_I2C
	bool
	help
	  Enable HAL REALTEK I2C driver

config USE_HAL_REALTEK_I2S
	bool
	help
	  Enable HAL REALTEK I2S driver

config USE_HAL_REALTEK_CODEC
	bool
	help
	  Enable HAL REALTEK CODEC driver

config USE_HAL_REALTEK_KEYSCAN
	bool
	help
	  Enable HAL REALTEK KEYSCAN driver

config USE_HAL_REALTEK_AON_QDEC
	bool
	help
	  Enable HAL REALTEK AON_QDEC driver

config USE_HAL_REALTEK_QDEC
	bool
	help
	  Enable HAL REALTEK QDEC driver

config USE_HAL_REALTEK_UART
	bool
	help
	  Enable HAL REALTEK UART driver

config USE_HAL_REALTEK_SPI
	bool
	help
	  Enable HAL REALTEK SPI driver

config USE_HAL_REALTEK_SPI3W
	bool
	help
	  Enable HAL REALTEK SPI3W driver

config USE_HAL_REALTEK_SDHC
	bool
	help
	  Enable HAL REALTEK SDHC driver

config USE_HAL_REALTEK_IR
	bool
	help
	  Enable HAL REALTEK IR driver

config USE_HAL_REALTEK_CAN
	bool
	help
	  Enable HAL REALTEK CAN driver

config USE_HAL_REALTEK_USB
	bool
	help
	  Enable HAL REALTEK USB driver

config USE_HAL_REALTEK_AON_WDT
	bool
	help
	  Enable HAL REALTEK AON WDT driver

config USE_HAL_REALTEK_CORE_WDT
	bool
	help
	  Enable HAL REALTEK CORE WDT driver

config USE_HAL_REALTEK_RCC
	bool
	help
	  Enable HAL REALTEK RCC driver

config USE_HAL_REALTEK_NVIC
	bool
	help
	  Enable HAL REALTEK NVIC driver

config USE_HAL_REALTEK_PINMUX
	bool
	help
	  Enable HAL REALTEK PINMUX driver

# Aliases for the HAL symbol names the upstream Realtek Bee drivers select, so
# that those drivers can be shared verbatim with the upstream tree.

config HAL_REALTEK_BEE_ADC
	bool
	select USE_HAL_REALTEK_ADC

config HAL_REALTEK_BEE_AON_QDEC
	bool
	select USE_HAL_REALTEK_AON_QDEC

config HAL_REALTEK_BEE_CAN
	bool
	select USE_HAL_REALTEK_CAN

config HAL_REALTEK_BEE_DMA
	bool
	select USE_HAL_REALTEK_DMA

config HAL_REALTEK_BEE_ENHTIM
	bool
	select USE_HAL_REALTEK_ENHTIM

config HAL_REALTEK_BEE_GPIO
	bool
	select USE_HAL_REALTEK_GPIO

config HAL_REALTEK_BEE_I2C
	bool
	select USE_HAL_REALTEK_I2C

config HAL_REALTEK_BEE_I2S
	bool
	select USE_HAL_REALTEK_I2S

config HAL_REALTEK_BEE_IR
	bool
	select USE_HAL_REALTEK_IR

config HAL_REALTEK_BEE_KEYSCAN
	bool
	select USE_HAL_REALTEK_KEYSCAN

config HAL_REALTEK_BEE_LPQDEC
	bool

config HAL_REALTEK_BEE_PWM
	bool

config HAL_REALTEK_BEE_QDEC
	bool
	select USE_HAL_REALTEK_QDEC

config HAL_REALTEK_BEE_RTC
	bool
	select USE_HAL_REALTEK_RTC

config HAL_REALTEK_BEE_SPI
	bool
	select USE_HAL_REALTEK_SPI

config HAL_REALTEK_BEE_TIM
	bool
	select USE_HAL_REALTEK_TIM

config HAL_REALTEK_BEE_UART
	bool
	select USE_HAL_REALTEK_UART
```
